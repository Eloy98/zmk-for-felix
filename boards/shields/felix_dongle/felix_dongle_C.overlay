/*
*
* Copyright (c) 2021 Darryl deHaan
* SPDX-License-Identifier: MIT
*
*/

#include "felix_dongle.dtsi"

/{
    chosen {
        zmk,kscan = &mock_kscan;
        zmk,physical-layout = &felix_layout;
    };
    mock_kscan: kscan_1 {
        compatible = "zmk,kscan-mock";
        columns = <0>;
        rows = <0>;
        events = <0>;
    };
};