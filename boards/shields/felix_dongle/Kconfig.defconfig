## boards/shields/felix_dongle/Kconfig.defconfig
```kconfig
if SHIELD_FELIX_DONGLE_C

config ZMK_KEYBOARD_NAME
    default "Felix"

config ZMK_SPLIT_ROLE_CENTRAL
    default y

endif


if SHIELD_FELIX_DONGLE_C || SHIELD_FELIX_DONGLE_L || SHIELD_FELIX_DONGLE_R

config ZMK_SPLIT
    default y

endif

if SHIELD_FELIX_DONGLE_L || SHIELD_FELIX_DONGLE_R

if ZMK_DISPLAY

config I2C
    default y

config SSD1306
    default y

choice ZMK_DISPLAY_WORK_QUEUE
    default ZMK_DISPLAY_WORK_QUEUE_DEDICATED
endchoice

endif

if SSD1306

config LV_Z_VDB_SIZE
    default 64

config LV_DPI_DEF
    default 148

config LV_Z_BITS_PER_PIXEL
    default 1

choice LV_COLOR_DEPTH
    default LV_COLOR_DEPTH_1
endchoice

endif

endif
```

## config/west.yml
```yaml
manifest:
  remotes:
    - name: zmkfirmware
      url-base: https://github.com/zmkfirmware
    - name: mctechnology17
      url-base: https://github.com/mctechnology17
    - name: carrefinho                           
      url-base: https://github.com/carrefinho  
  projects:
    - name: zmk
      remote: zmkfirmware
      revision: v0.3
      import: app/west.yml
    - name: zmk-nice-oled
      remote: mctechnology17
      revision: main
    - name: prospector-zmk-module                 
      remote: carrefinho                         
      revision: main 
  self:
    path: config
```
